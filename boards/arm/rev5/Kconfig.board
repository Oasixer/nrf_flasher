## boards/arm/rev5/Kconfig.board
```kconfig
# Copyright (c) 2024 Nordic Semiconductor ASA
# SPDX-License-Identifier: Apache-2.0

config BOARD_REV5
	bool "rev5 board"
	depends on SOC_NRF52840_QFAA

# config HAS_I_CHG 
#     bool "Board has an I_CHG pin"
```

## boards/arm/rev5/Kconfig.defconfig
```kconfig
# Copyright (c) 2024 Nordic Semiconductor ASA
# SPDX-License-Identifier: Apache-2.0

if BOARD_REV5

config BOARD
	default "rev5"

config BT_CTLR
   default BT

endif
```

## boards/arm/rev5/rev5_defconfig
```kconfig
CONFIG_SOC_SERIES_NRF52X=y
CONFIG_SOC_NRF52840_QFAA=y
CONFIG_USE_SEGGER_RTT=y
# Logger gets compiled out if you set these to n
# CONFIG_LOG=y
# CONFIG_USE_SEGGER_RTT=y
```
